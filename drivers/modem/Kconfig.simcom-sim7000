## drivers/modem/Kconfig.simcom-sim7000
```kconfig
# Simcom sim7000 driver options

# Copyright (C) 2023 Rafael Dias Menezes <rdmeneze@gmail.com>
# SPDX-License-Identifier: Apache-2.0

config MODEM_SIM7000
	bool "Sim7000 Driver"
	select MODEM_CONTEXT
	select MODEM_CMD_HANDLER
	select MODEM_IFACE_UART
	select MODEM_SOCKET
	select NET_OFFLOAD
	select NET_SOCKETS_OFFLOAD
	imply GPIO
	help
	  Enables the driver for the Sim7000 modem.

if MODEM_SIM7000

config MODEM_SIMCOM_SIM7000_RX_STACK_SIZE
	int "Stack size for the simcom sim7000 modem driver rx thread"
	default 1028
	help
	  This stack is used by the simcom SIM7000 RX thread.

config MODEM_SIMCOM_SIM7000_RX_WORKQ_STACK_SIZE
	int "Stack size for the simcom sim7000 modem driver work queue"
	default 2048
	help
		This stack is used by the work queue.

config MODEM_SIMCOM_SIM7000_INIT_PRIORITY
	int "simcom sim7000 driver init priority"
	default 80
	help
	  simcom sim7000 driver initialization priority.

config MODEM_SIMCOM_SIM7000_LTE_BANDS
	string "LTE bands the driver can use"
	default "8,20,28"
	help
		Comma separated list of usable lte bands.

config MODEM_SIMCOM_SIM7000_APN
	string "APN for establishing a network connection"
	default "internet"
	help
	  This setting is used to set the APN name for the network connection
	  context. This value is specific to the network provider and may
	  need to be changed.

choice MODEM_SIMCOM_SIM7000_RAT
	bool "Radio Access Technology Mode"
	default MODEM_SIMCOM_SIM7000_RAT_NB1

config MODEM_SIMCOM_SIM7000_RAT_NB1
	bool "NB-IoT"
	help
		Enable LTE NB-IoT mode.

config MODEM_SIMCOM_SIM7000_RAT_M1
	bool "Cat-M1"
	help
		Enable Cat-M1 mode.

config MODEM_SIMCOM_SIM7000_RAT_GSM
	bool "GSM"
	help
	  Enable GSM mode.

endchoice

endif # MODEM_SIM7000
```
