## boards/shields/dfrobot_sim7000/Kconfig.shield
```kconfig
# SPDX-FileCopyrightText: Copyright (c) 2026 Rafael Dias Menezes <rdmeneze@gmail.com>
# SPDX-License-Identifier: Apache-2.0

config SHIELD_DFROBOT_SIM7000
	def_bool $(shields_list_contains,dfrobot_sim7000)
```

## drivers/modem/vendor_standalone/simcom/sim7000/Kconfig
```kconfig
# Simcom sim7000 driver options

# Copyright (C) 2026 Rafael Dias Menezes <rdmeneze@gmail.com>
# SPDX-License-Identifier: Apache-2.0

config MODEM_SIM7000
	bool "Sim7000 Driver"
	select MODEM_CONTEXT
	select MODEM_CMD_HANDLER
	select MODEM_IFACE_UART
	select MODEM_SOCKET
	select NET_OFFLOAD
	select NET_SOCKETS_OFFLOAD
	imply GPIO
	help
	  Enables the driver for the Sim7000 modem.

if MODEM_SIM7000

config MODEM_SIMCOM_SIM7000_RX_STACK_SIZE
	int "Stack size for the simcom sim7000 modem driver rx thread"
	default 1028
	help
	  This stack is used by the simcom SIM7000 RX thread.

config MODEM_SIMCOM_SIM7000_RX_WORKQ_STACK_SIZE
	int "Stack size for the simcom sim7000 modem driver work queue"
	default 2048
	help
		This stack is used by the work queue.

config MODEM_SIMCOM_SIM7000_INIT_PRIORITY
	int "simcom sim7000 driver init priority"
	default 80
	help
	  simcom sim7000 driver initialization priority.

config MODEM_SIMCOM_SIM7000_LTE_BANDS_M1
	hex "Default LTE bands for CAT-M1"
	default 0x8820
	help
		Bitmap of channels the modem can use for CAT-M1.
		Refer to enum sim7000_lte_chan.

config MODEM_SIMCOM_SIM7000_LTE_BANDS_NB1
	hex "Default LTE bands for NB-IoT"
	default 0x8820
	help
		Bitmap of channels the modem can use for NB-IoT.
		Refer to enum sim7000_lte_chan.

config MODEM_SIMCOM_SIM7000_BAUDRATE
	int "Baudrate for modem UART"
	default 115200
	help
		Set this to the baudrate the uart is using. On first startup
		the modem is configured to use autobaud. The driver will then
		configure the modem to use a fixed baudrate for faster startups.

config MODEM_SIMCOM_SIM7000_DNS_DEFAULT_RECOUNT
	int "Retry count for a DNS query"
	range 0 10
	default 10
	help
		The number of retries for a DNS lookup

config MODEM_SIMCOM_SIM7000_DNS_DEFAULT_TIMEOUT
	int "Timeout for a DNS query"
	range 0 60000
	default 20000
	help
		The timeout for DNS queries in milliseconds

choice MODEM_SIMCOM_SIM7000_RAT
	bool "Default Radio Access Technology Mode"
	default MODEM_SIMCOM_SIM7000_RAT_NB1

config MODEM_SIMCOM_SIM7000_RAT_NB1
	bool "NB-IoT"
	help
		Enable LTE NB-IoT mode.

config MODEM_SIMCOM_SIM7000_RAT_M1
	bool "Cat-M1"
	help
		Enable Cat-M1 mode.

config MODEM_SIMCOM_SIM7000_RAT_LTE_AUTO
	bool "Automatic selection of NB-IoT or Cat-M1"
	help
		Enable automatic LTE technology selection.

config MODEM_SIMCOM_SIM7000_RAT_GSM
	bool "GSM"
	help
	  Enable GSM mode.

endchoice

endif # MODEM_SIM7000
```

## dts/bindings/modem/simcom,sim7000.yaml
```yaml
# Copyright (C) 2026 Rafael Dias Menezes <rdmeneze@gmail.com>
# SPDX-License-Identifier: Apache-2.0

description: Simcom Sim7000 modem

compatible: "simcom,sim7000"

include: zephyr,cellular-modem-device.yaml

properties:
  mdm-power-gpios:
    type: phandle-array
    required: true
```
